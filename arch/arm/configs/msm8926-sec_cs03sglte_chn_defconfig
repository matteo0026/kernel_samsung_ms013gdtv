## arch/arm/configs/msm8926-sec_cs03sglte_chn_defconfig
```kconfig
#variant defconfig
CONFIG_MACH_CS03_SGLTE=y
# CONFIG_MACH_MS01_LTE is not set

#Battery
CONFIG_QPNP_SEC_CHARGER=y
CONFIG_QPNP_BMS=y
CONFIG_BATTERY_BCL=y

#LCD
CONFIG_FB_MSM_MDSS_MAGNA_WVGA_PANEL=y
# CONFIG_ESD_ERR_FG_RECOVERY=y
CONFIG_FB_MSM_MDSS=y
CONFIG_FB_MSM_MDSS_WRITEBACK=y
CONFIG_BACKLIGHT_LCD_SUPPORT=y
#CONFIG_MDNIE_LITE_TUNING is not set
CONFIG_LCD_CLASS_DEVICE=y
CONFIG_BACKLIGHT_CLASS_DEVICE=y
#CONFIG_BACKLIGHT_GENERIC is not set

#TOUCH
CONFIG_TOUCHSCREEN_MMS152=n
CONFIG_TOUCHSCREEN_BCMTCH15XXX=n
CONFIG_KEYBOARD_CYPRESS_TOUCH=n
CONFIG_TOUCHSCREEN_ZINITIX_BT531=n
CONFIG_TOUCHSCREEN_ATMEL_MXTS=y
CONFIG_KEYBOARD_CYPRESS_TOUCH_20234=y

#Vibrator
CONFIG_MSM_VIBRATOR=y
CONFIG_QPNP_VIBRATOR=y

#HallSensor
CONFIG_SENSORS_HALL=n

#USB
CONFIG_USB_ANDROID_SAMSUNG_COMPOSITE=y
CONFIG_USB_ANDROID_SAMSUNG_MTP=y
CONFIG_USB_HOST_NOTIFY=y
CONFIG_USB_DUN_SUPPORT=y


#MUIC
# CONFIG_USB_SWITCH_TSU6721 is not set
CONFIG_USB_SWITCH_RT8973=y

#SENSORS
CONFIG_SENSORS_CORE=y
CONFIG_INPUT_YAS_SENSORS=n
CONFIG_YAS_ACC_MULTI_SUPPORT=n
CONFIG_INPUT_YAS_ACCELEROMETER=n
CONFIG_YAS_ACC_DRIVER_BMA250=n
CONFIG_INPUT_YAS_ACCELEROMETER_POSITION=1
# CONFIG_SENSORS_HSCDTD008A is not set
CONFIG_INPUT=y
CONFIG_INPUT_GPIO=y
CONFIG_INPUT_POLLDEV=y
# CONFIG_INPUT_MPU6500 is not set
# CONFIG_INPUT_MPU6500_SELFTEST is not set
# CONFIG_INPUT_MPU6500_POLLING is not set
CONFIG_OPTICAL_TAOS=y
CONFIG_BMA250_ACC_DRIVER=y

#CAMERA
CONFIG_S5K3H5XA=y
CONFIG_S5K4H5YA=y
CONFIG_S5K4H5YB=y
CONFIG_S5K6A3YX=y

#WIFI
#no need

#BT
#no need

# Earjack
CONFIG_SAMSUNG_JACK=y
```

## drivers/media/isdbt/Kconfig
```kconfig
#
# ISDBT config states
#

config ISDBT
	bool "ISDB-T"
	help
	  This allows ISDBT.
	  This module is designed for SPI or TSIF.
	  Select chipset and interface

config ISDBT_FC8300
	depends on ISDBT
	bool "FCI"

config ISDBT_VENDOR_RAONTECH
	depends on ISDBT
	bool "RAONTECH"

choice
	depends on ISDBT && ISDBT_VENDOR_RAONTECH
	prompt "chip"
	default ISDBT_MTV23x
	config ISDBT_MTV23x
		bool "MTV23x"

	config ISDBT_MTV222
		bool "MTV222"

endchoice
```
